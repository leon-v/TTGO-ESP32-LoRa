## components/http/Kconfig
```kconfig
menu "HTTP NVS"

config HTTP_NVS_MAX_STRING_LENGTH
    int "Max NVS Length"
    range 0 256
    default 128
    help
	The longest string allowed to be held by NVS

endmenu
```
